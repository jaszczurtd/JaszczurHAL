#include <hal/hal_app.h>
#include <hal/hal_display.h>
#include <hal/hal_system.h>
#include <tools_c.h>
#include <utils/lodepng.h>

#include <stdlib.h>
#include <string.h>

static const uint8_t TFT_CS_PIN = 17;
static const uint8_t TFT_DC_PIN = 20;
static const uint8_t TFT_RST_PIN = 21;

static const int DISPLAY_WIDTH = 240;
static const int DISPLAY_HEIGHT = 320;

/*
 * This is the firmware asset: a PNG file encoded as Base64 text. The string is
 * generated by scripts/image_to_base64.py and lives in flash/rodata instead of
 * being loaded from a filesystem.
 */
static const char kBase64PngImage[] =
    "iVBORw0KGgoAAAANSUhEUgAAABgAAAAYCAYAAADgdz34AAAAqklEQVR42pXNuw2AQAwE0a2EhJ"
    "SI"
    "IiiCOimHmDaAQ4C44z47lixHnqf9nK0b7O2Wyd4wCk8EIfFw9Ty6CIlHgIuQ+"
    "A9wEBLPAi2ExItA"
    "DSHxKlBCSLwJ5BASt4AUIXEb+CIkjoAHIfEL6Od1d/eddbRXJH7d8AgQkfgLAEQkHgEmIhL/"
    "AQYi"
    "Es8CDUQkXgQqiEi8ChQQkXgTyCAicQtIEJG4DXwQkTgCbuQAPO27NBt3V+"
    "IAAAAASUVORK5CYII=";

/* Multiplications involving decoded image dimensions are checked explicitly:
 * a malformed PNG header must not wrap size_t and produce a tiny allocation.
 */
static bool checked_mul_size(size_t a, size_t b, size_t *out) {
  if (out == NULL) {
    return false;
  }
  if (a != 0u && b > (((size_t)-1) / a)) {
    *out = 0u;
    return false;
  }
  *out = a * b;
  return true;
}

static bool inspect_png_dimensions(const uint8_t *png_data, size_t png_size,
                                   unsigned *width, unsigned *height,
                                   unsigned *png_error) {
  /* lodepng_inspect() reads IHDR and validates enough PNG structure to obtain
   * width/height. It does not inflate IDAT or allocate the full RGBA image.
   */
  LodePNGState state;
  lodepng_state_init(&state);
  unsigned error = lodepng_inspect(width, height, &state, png_data, png_size);
  lodepng_state_cleanup(&state);

  if (png_error != NULL) {
    *png_error = error;
  }
  return error == 0u;
}

static bool decode_base64_png_to_rgb565_for_display(
    const char *base64_png, size_t base64_len, int display_width,
    int display_height, uint16_t **rgb565, unsigned *width, unsigned *height,
    unsigned *png_error) {
  if (rgb565 != NULL) {
    *rgb565 = NULL;
  }
  if (width != NULL) {
    *width = 0u;
  }
  if (height != NULL) {
    *height = 0u;
  }
  if (png_error != NULL) {
    *png_error = 0u;
  }

  if (base64_png == NULL || rgb565 == NULL || width == NULL || height == NULL ||
      display_width <= 0 || display_height <= 0) {
    return false;
  }

  /* Base64 has a deterministic decoded size. Query it first, then allocate an
   * exactly sized PNG work buffer instead of guessing with a fixed array.
   */
  size_t png_size = 0u;
  if (!pngBase64DecodedSize(base64_png, base64_len, &png_size) ||
      png_size == 0u) {
    derr("base64 size query failed");
    return false;
  }

  uint8_t *png_work = (uint8_t *)malloc(png_size);
  if (png_work == NULL) {
    derr("png work allocation failed size=%lu", (unsigned long)png_size);
    return false;
  }

  size_t decoded_png_size = 0u;
  if (!hal_base64_decode(base64_png, base64_len, png_work, png_size,
                         &decoded_png_size) ||
      decoded_png_size != png_size) {
    derr("base64 decode failed");
    free(png_work);
    return false;
  }

  /* Reject images that cannot fit on the panel before lodepng_decode32()
   * allocates a width * height * 4 RGBA buffer. Passing this check does not
   * guarantee the image fits in RAM: RGB565 and RGBA allocations below are the
   * real memory-budget checks.
   */
  unsigned inspected_width = 0u;
  unsigned inspected_height = 0u;
  if (!inspect_png_dimensions(png_work, png_size, &inspected_width,
                              &inspected_height, png_error)) {
    derr("png inspect failed error=%u", png_error != NULL ? *png_error : 0u);
    free(png_work);
    return false;
  }

  if (inspected_width > (unsigned)display_width ||
      inspected_height > (unsigned)display_height) {
    derr("png %ux%u exceeds display %dx%d", inspected_width, inspected_height,
         display_width, display_height);
    free(png_work);
    return false;
  }

  /* After the bounds check, the RGB565 output size is known exactly:
   * one 16-bit pixel per image pixel.
   */
  size_t pixels = 0u;
  size_t rgb565_bytes = 0u;
  if (!checked_mul_size((size_t)inspected_width, (size_t)inspected_height,
                        &pixels) ||
      !checked_mul_size(pixels, sizeof(uint16_t), &rgb565_bytes)) {
    derr("png dimensions overflow");
    free(png_work);
    return false;
  }

  /* This allocation is also the RAM budget check. A full 240x320 RGB565 image
   * is 153600 bytes, so it will not fit in the STM32G474 96 KB RAM profile even
   * though it matches the panel resolution. In that case we reject before the
   * larger temporary RGBA8888 decode allocation is attempted.
   */
  uint16_t *rgb565_buffer = (uint16_t *)malloc(rgb565_bytes);
  if (rgb565_buffer == NULL) {
    derr("rgb565 allocation failed");
    free(png_work);
    return false;
  }

  /* LodePNG still needs a temporary RGBA8888 buffer. It is freed immediately
   * after conversion to RGB565.
   */
  unsigned char *rgba = NULL;
  unsigned decoded_width = 0u;
  unsigned decoded_height = 0u;
  unsigned error = lodepng_decode32(&rgba, &decoded_width, &decoded_height,
                                    png_work, png_size);
  free(png_work);
  if (png_error != NULL) {
    *png_error = error;
  }
  if (error != 0u || rgba == NULL) {
    derr("png decode failed error=%u", error);
    free(rgb565_buffer);
    free(rgba);
    return false;
  }

  /* The post-decode dimension comparison is defensive: it catches unexpected
   * disagreement between the inspected IHDR and the decoded result.
   */
  bool ok = decoded_width == inspected_width &&
            decoded_height == inspected_height &&
            rgba8888ToRgb565(rgba, rgb565_buffer, pixels);
  free(rgba);

  if (!ok) {
    free(rgb565_buffer);
    return false;
  }

  *rgb565 = rgb565_buffer;
  *width = decoded_width;
  *height = decoded_height;
  return true;
}

static void draw_base64_png(void) {
  uint16_t *rgb565 = NULL;
  unsigned image_width = 0u;
  unsigned image_height = 0u;
  unsigned png_error = 0u;

  if (!decode_base64_png_to_rgb565_for_display(
          kBase64PngImage, sizeof(kBase64PngImage) - 1u,
          hal_display_get_width(), hal_display_get_height(), &rgb565,
          &image_width, &image_height, &png_error)) {
    hal_display_set_default_font_with_pos_and_color(8, 8, HAL_COLOR_RED);
    hal_display_print("PNG rejected");
    return;
  }

  int x = (hal_display_get_width() - (int)image_width) / 2;
  int y = (hal_display_get_height() - (int)image_height) / 2;
  hal_display_fill_screen(HAL_COLOR_BLACK);
  hal_display_draw_rgb_bitmap(x, y, rgb565, (int)image_width,
                              (int)image_height);
  /* The display driver copies/sends the bitmap synchronously, so the temporary
   * RGB565 buffer can be released after the draw call returns.
   */
  free(rgb565);
}

void app_start(void) {
  debugInit();
  hal_deb_set_prefix("PNG-DSP");

  hal_display_init(TFT_CS_PIN, TFT_DC_PIN, TFT_RST_PIN);
  if (!hal_display_configure(DISPLAY_WIDTH, DISPLAY_HEIGHT,
                             HAL_DISPLAY_ROTATION(0), HAL_DISPLAY_INVERT_OFF,
                             HAL_DISPLAY_COLOR_ORDER_RGB)) {
    derr("display configure failed");
    return;
  }

  draw_base64_png();
}

void app_task0(void) { hal_delay_ms(1000u); }
